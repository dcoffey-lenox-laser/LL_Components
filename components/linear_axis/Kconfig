## components/linear_axis/Kconfig
```kconfig
menu "Linear Axis"
    
    config ENABLE_HOME_LIMIT
        bool "Is there a home limit on the axis"
        default y
        help 
            Check if a home limit is available on the axis 
   
    config HOME_LIMIT_PIN
        int "GPIO for home limit input pin"
        depends on ENABLE_HOME_LIMIT
        default 46
        help 
            GPIO number for the pin connected to the home limit switch
    
    config ENABLE_AWAY_LIMIT
        bool "Is there an away limit on the axis"
        default y
        help
            Check if an away limit is available on the axis
    
    config AWAY_LIMIT_PIN
        int "GPIO for await limit input pin"
        depends on ENABLE_AWAY_LIMIT
        default 8
        help
            GPIO number for the pin connected to the away limit switch 

    config MINIMUM_POSITION
        int "Lowest position the axis can reach in native steps"
        default -2000
        help 
            Minimum position that the axis can reach assuming that home is at position 0.

    config MAXIMUM_POSITION
        int "Highest position the axis can reach in native steps"
        default 10000000
        help 
            Maximum position that the axis can reach assuming that home is at position 0 and away is positive.

    config UNITS_PER_REV
        float "Units per revolution"
        default 3200
        help
            Number of units the axis travels in one rotation of the motor
    
    choice AXIS_UNITS
        prompt "Select the axis units"
        default USE_NATIVE

        config USE_NATIVE
            bool "NATIVE UNITS"
        config USE_MILLIMETERS
            bool "MILLIMETERS"
        config USE_INCHES
            bool "INCHES"
    endchoice

    config AXIS_UNITS_VAL
        int
        default 0 if USE_NATIVE
        default 1 if USE_MILLIMETERS
        default 2 if USE_INCHES

    config USE_ENCODER
        bool "Is an encoder on this axis"
        default y
        help 
            Is there an encoder included on this axis
    
    config ENCODER_STEPS_PER_UNIT
        int "Steps on encoder after 1 unit of travel"
        depends on USE_ENCODER
        default 1
        help 
            The number of steps the encoder will travel if the axis moves 1 unit
        
        config MAXIMUM_ERROR
            float "Maximum error in selected units"
            default "1"

endmenu
```

## components/quadrature_encoder/Kconfig
```kconfig
menu "Quadrature Encoder"
    config A_PIN
        int "GPIO for A channel"
        default 40
        help 
            GPIO number for the pin connected to the encoder's A channel
    
    config B_PIN
        int "GPIO for B channel"
        default 41
        help
            GPIO number for the pin connected to the encoder's B channel
    
    config Z_PIN
        int "GPIO for Z channel"
        default 42
        help 
            GPIO number for the pin connected to the encoder's Z channel

endmenu
```

## components/stepper_driver/Kconfig
```kconfig
menu "Stepper Driver"

    config DIRECTION_PIN
        int "Direction GPIO Number"
        default 4 
        help
            GPIO number for the pin connected to driver direction pin.

    config CLOCKWISE_LEVEL
        int "Level of DIR pin for clockwise rotation"
        range 0 1
        default 1
        help 
            Level of the direction GPIO pin when steps will be done in a clockwise direction

    config ENABLE_PIN
        int "Enable GPIO Number"
        default 5
        help
            GPIO number for the pin connected to the driver enable pin. 

    config ENABLED_LEVEL
        int "Level of EN pin when motor is energized"
        range 0 1
        default 1
        help
            Level of the enable GPIO pin when the motor is energized
    
    config  STEP_PIN
        int "Step pin GPIO number"
        default 6
        help
            GPIO number for the pin connected to the driver step pin
           
    config STEPS_PER_REV
        int "Steps per revolution"
        default 200
        help
            Number of steps in one rotation of the stepper motor. Not including microstepping
    
    config MICROSTEPS_PER_STEP
        int "Microsteps per Step"
        default 1
        help
            Number of microsteps per single step of the motor
endmenu
```
